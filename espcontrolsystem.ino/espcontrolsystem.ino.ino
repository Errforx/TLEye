// ESP32 HTTPS Traffic Light Controller with Existing Cert
// Adapted for HTTPS using ESP32 HTTPS Server library
// Removed self-signed cert generation; use your existing DER-encoded cert and key

#include <WiFi.h>
#include <HTTPSServer.hpp>
#include <SSLCert.hpp>
#include <HTTPRequest.hpp>
#include <HTTPResponse.hpp>
#include <ResourceNode.hpp>

using namespace httpsserver;

// AP credentials (keep your originals)
const char* ap_ssid = "TLEye System";
const char* ap_password = "lamokglala";

// LED pins (keep your originals)
const int LED_GREEN = 4;
const int LED_YELLOW = 16;
const int LED_RED = 17;

// Secondary Traffic Light
const int sLED_Green = 19;
const int sLED_Yellow = 18;
const int sLED_Red = 5;

#define SEG_A 25
#define SEG_B 14
#define SEG_C 12
#define SEG_D 33
#define SEG_E 32
#define SEG_F 27
#define SEG_G 26

// Digit select pins
#define DIGIT_1 23    // Tens
#define DIGIT_2 13    // Ones

// Timer variables (keep your originals)
unsigned long segtimerStart = 0;
unsigned long segtimerDuration = 0;
bool segtimerRunning = false;
unsigned long seglastRefresh = 0;
bool segtoggleDigit = false;

// Digit map (keep your originals)
const byte digitMap[10][7] = {
  {1,1,1,1,1,1,0}, // 0
  {0,1,1,0,0,0,0}, // 1
  {1,1,0,1,1,0,1}, // 2
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  {1,1,1,1,0,1,1}  // 9
};

// DER-encoded private key (RSA) - replace with your own (from openssl pkey -in key.pem -outform DER | xxd -i)
const uint8_t rsakey[] PROGMEM = {
  "0x30, 0x82, 0x09, 0x28, 0x02, 0x01, 0x00, 0x02, 0x82, 0x02, 0x01, 0x00,
  0xa0, 0x49, 0x2e, 0x9d, 0x17, 0x5b, 0x18, 0x06, 0x5f, 0xdf, 0x0f, 0x46,
  0xd0, 0xa4, 0xe1, 0xc2, 0x86, 0xa9, 0x96, 0xaf, 0x4d, 0x6c, 0xb2, 0xb8,
  0x55, 0xee, 0x82, 0xb6, 0x59, 0xba, 0x80, 0xca, 0xa7, 0x90, 0x39, 0xdd,
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  0x1b, 0x07, 0xcd, 0xc7, 0xab, 0x43, 0xa7, 0xaa, 0xd4, 0x34, 0xa4, 0x0c,
  0xcd, 0x82, 0xb5, 0x70, 0x0b, 0x56, 0x70, 0x3b"

};

// DER-encoded certificate (X.509) - replace with your own (from openssl x509 -in cert.pem -outform DER | xxd -i)
const uint8_t x509[] PROGMEM = {
  "0x30, 0x82, 0x06, 0x09, 0x30, 0x82, 0x03, 0xf1, 0xa0, 0x03, 0x02, 0x01,
  0x02, 0x02, 0x14, 0x1f, 0x17, 0x16, 0x3d, 0x6f, 0x1c, 0x97, 0xfb, 0x0c,
  0x50, 0x23, 0xd8, 0x5b, 0x1f, 0x34, 0xf8, 0xe5, 0x90, 0x17, 0x40, 0x30,
  0x0d, 0x06, 0x09, 0x2a, 0x86, 0x48, 0x86, 0xf7, 0x0d, 0x01, 0x01, 0x0b,
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  0x2f, 0x95, 0xa9, 0x0f, 0x94, 0x83, 0x24, 0x1e, 0x9c, 0xcc, 0x6d, 0xaf,
  0xe7"
};

// HTTPS server and cert
SSLCert *cert;
HTTPSServer *server;

// Siren blink control (keep your originals)
bool siren_active = false;
unsigned long last_blink = 0;
bool blink_state = false;

// Handler for /set_mode?mode=xxx
void handleSetMode(HTTPRequest *req, HTTPResponse *res) {
  // Check for "mode" parameter
  std::string mode = req->getParams()->get("mode");

  if (!mode.empty()) {
    // Reset siren if not siren mode
    if (mode != "siren_on") {
      siren_active = false;
    }

    if (mode == "red") {
      startTimer(30);
      digitalWrite(LED_RED, HIGH);
      digitalWrite(LED_YELLOW, LOW);
      digitalWrite(LED_GREEN, LOW);
      digitalWrite(sLED_Green, HIGH);
      digitalWrite(sLED_Yellow, LOW);
      digitalWrite(sLED_Red, LOW);
    } else if (mode == "green") {
      startTimer(30);
      digitalWrite(LED_RED, LOW);
      digitalWrite(LED_YELLOW, LOW);
      digitalWrite(LED_GREEN, HIGH);
      digitalWrite(sLED_Green, LOW);
      digitalWrite(sLED_Yellow, LOW);
      digitalWrite(sLED_Red, HIGH);
    } else if (mode == "yellow") {
      startTimer(3);
      digitalWrite(LED_RED, LOW);
      digitalWrite(LED_YELLOW, HIGH);
      digitalWrite(LED_GREEN, LOW);
      digitalWrite(sLED_Green, LOW);
      digitalWrite(sLED_Yellow, HIGH);
      digitalWrite(sLED_Red, LOW);
    } else if (mode == "siren_on") {
      siren_active = true;
      startTimer(10);
      last_blink = millis();
      blink_state = false;  // Start with off
    } else if (mode == "killall") {
      digitalWrite(LED_RED, LOW);
      digitalWrite(LED_YELLOW, LOW);
      digitalWrite(LED_GREEN, LOW);
      digitalWrite(sLED_Green, LOW);
      digitalWrite(sLED_Yellow, LOW);
      digitalWrite(sLED_Red, LOW);
    }

    res->setStatusCode(200);
    res->setStatusText("OK");
    res->println("OK");
  } else {
    res->setStatusCode(400);
    res->setStatusText("Missing mode parameter");
    res->println("Missing mode parameter");
  }
}

void setup() {
  // Initialize LEDs (keep your originals)
  pinMode(LED_GREEN, OUTPUT);
  pinMode(LED_YELLOW, OUTPUT);
  pinMode(LED_RED, OUTPUT);
  digitalWrite(LED_GREEN, LOW);
  digitalWrite(LED_YELLOW, LOW);
  digitalWrite(LED_RED, LOW);

  pinMode(sLED_Green, OUTPUT);
  pinMode(sLED_Yellow, OUTPUT);
  pinMode(sLED_Red, OUTPUT);
  digitalWrite(sLED_Green, LOW);
  digitalWrite(sLED_Yellow, LOW);
  digitalWrite(sLED_Red, LOW);

  // Serial for debugging
  Serial.begin(115200);

  // Start in AP mode (keep your originals)
  WiFi.mode(WIFI_AP);
  WiFi.softAP(ap_ssid, ap_password);
  
  // Set static IP for ESP32 in AP mode
  IPAddress apIP(192, 168, 4, 1);
  IPAddress gateway(192, 168, 4, 1);
  IPAddress subnet(255, 255, 255, 0);
  WiFi.softAPConfig(apIP, gateway, subnet);

  Serial.println();
  Serial.print("Access Point started! SSID: ");
  Serial.println(ap_ssid);
  Serial.print("IP address: ");
  Serial.println(WiFi.softAPIP());  // Should print 192.168.4.1

  // Setup 7-segment display (keep your originals)
  setupDisplay();

  // Use existing DER-encoded cert and key
  Serial.println("Loading existing certificate...");

  cert = new SSLCert(
    x509, sizeof(x509),  // DER cert
    rsakey, sizeof(rsakey)  // DER key
  );

  // Initialize HTTPS server with the cert
  server = new HTTPSServer(cert);

  // Register the /set_mode handler (GET method)
  ResourceNode *nodeSetMode = new ResourceNode("/set_mode", "GET", &handleSetMode);
  server->registerNode(nodeSetMode);

  // Start server
  Serial.println("Starting HTTPS server...");
  server->start();
  if (server->isRunning()) {
    Serial.println("HTTPS server ready on https://192.168.4.1:443");
  }
}

void loop() {
  updateTimerDisplay();
  server->loop();  // Handle HTTPS requests (non-blocking)

  // Handle siren blinking if active (keep your originals)
  if (siren_active) {
    unsigned long now = millis();
    if (now - last_blink >= (blink_state ? 1000 : 400)) {
      blink_state = !blink_state;
      if (blink_state) {
        digitalWrite(LED_RED, HIGH);
        digitalWrite(LED_YELLOW, HIGH);
        digitalWrite(LED_GREEN, HIGH);
        digitalWrite(sLED_Green, LOW);
        digitalWrite(sLED_Yellow, LOW);
        digitalWrite(sLED_Red, HIGH);
      } else {
        digitalWrite(LED_RED, LOW);
        digitalWrite(LED_YELLOW, LOW);
        digitalWrite(LED_GREEN, LOW);
        digitalWrite(sLED_Green, LOW);
        digitalWrite(sLED_Yellow, LOW);
        digitalWrite(sLED_Red, LOW);
      }
      last_blink = now;
    }
  }
}

// Keep your original functions for display and timer
void setupDisplay() {
  pinMode(SEG_A, OUTPUT);
  pinMode(SEG_B, OUTPUT);
  pinMode(SEG_C, OUTPUT);
  pinMode(SEG_D, OUTPUT);
  pinMode(SEG_E, OUTPUT);
  pinMode(SEG_F, OUTPUT);
  pinMode(SEG_G, OUTPUT);

  pinMode(DIGIT_1, OUTPUT);
  pinMode(DIGIT_2, OUTPUT);

  digitalWrite(DIGIT_1, LOW);
  digitalWrite(DIGIT_2, LOW);
}

void displayDigit(int digit, int digitPin) {
  digitalWrite(DIGIT_1, LOW);
  digitalWrite(DIGIT_2, LOW);

  digitalWrite(SEG_A, digitMap[digit][0]);
  digitalWrite(SEG_B, digitMap[digit][1]);
  digitalWrite(SEG_C, digitMap[digit][2]);
  digitalWrite(SEG_D, digitMap[digit][3]);
  digitalWrite(SEG_E, digitMap[digit][4]);
  digitalWrite(SEG_F, digitMap[digit][5]);
  digitalWrite(SEG_G, digitMap[digit][6]);

  digitalWrite(digitPin, HIGH);
}

void startTimer(int seconds) {
  segtimerDuration = seconds * 1000UL;
  segtimerStart = millis();
  segtimerRunning = true;
}

void updateTimerDisplay() {
  if (!segtimerRunning) return;

  unsigned long elapsed = millis() - segtimerStart;

  if (elapsed >= segtimerDuration) {
    segtimerRunning = false;
    digitalWrite(DIGIT_1, LOW);
    digitalWrite(DIGIT_2, LOW);
    return;
  }

  int remaining = (segtimerDuration - elapsed) / 1000;
  int tens = remaining / 10;
  int ones = remaining % 10;

  if (millis() - seglastRefresh > 3) {
    seglastRefresh = millis();
    segtoggleDigit = !segtoggleDigit;

    if (segtoggleDigit)
      displayDigit(tens, DIGIT_1);
    else
      displayDigit(ones, DIGIT_2);
  }
}